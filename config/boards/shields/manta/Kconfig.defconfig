## config/boards/shields/rhosweep/Kconfig.defconfig
```kconfig
# Copyright (c) 2020 The ZMK Contributors
# SPDX-License-Identifier: MIT

if SHIELD_RHOSWEEP_LEFT

config ZMK_KEYBOARD_NAME
	default "rhosweep"

config ZMK_SPLIT_ROLE_CENTRAL
	default y

endif

if SHIELD_RHOSWEEP_LEFT || SHIELD_RHOSWEEP_RIGHT

config ZMK_SPLIT
	default y

endif
```

## config/boards/shields/rhosweep/Kconfig.shield
```kconfig
# Copyright (c) 2020 The ZMK Contributors
# SPDX-License-Identifier: MIT

config SHIELD_RHOSWEEP_LEFT
	def_bool $(shields_list_contains,rhosweep_left)

config SHIELD_RHOSWEEP_RIGHT
	def_bool $(shields_list_contains,rhosweep_right)
```
